## config/west.yml
```yaml
# CAUTION! 
# Branch name comments are crucial for `nix run .#update`, so don't delete them

manifest:
  remotes:
    - name: steno
      url-base: https://github.com/lazerwalker
    - name: xopclabs
      url-base: https://github.com/xopclabs
    - name: urob
      url-base: https://github.com/urob

  projects:
    - name: zmk
      remote: steno
      revision: 40b2031c6df42611148656f162593a95b4c5c4ef # multiple-features
      import: app/west.yml

    - name: zmk-lang-switch
      remote: xopclabs
      revision: 42c9561cad59d8ea8ed0619e678767916c8851ef # main
    - name: zmk-helpers
      remote: urob
      revision: bc114546392b4615ac90a99140eaf21dde31209d  # main

  self:
    path: config
```
