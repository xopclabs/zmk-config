/ {
    conditional_layers {
        compatible = "zmk,conditional-layers";
        opts_main_tri_layer {
            if-layers = <NUM FUNC>;
            then-layer = <OPTS>;
        };
        opts_game_tri_layer {
            if-layers = <NUM GAME_SECOND>;
            then-layer = <OPTS>;
        };
    };
};
